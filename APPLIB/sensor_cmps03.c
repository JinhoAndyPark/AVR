/*==============================================================================
 *
 *        cmps03 Module(I2c version)
 *
 *        File Name   		: sensor_cmps03.c
 *        Version        	: 1.0
 *        Date           	: 2006.07.13
 *        Author         	: Kooksun Lee (ROLAB 20th, Kwangwoon University)
 *        MPU_Type       	: ATmega128(16MHz)
 *        Modified       	: 2006.07.13 By L. K. S
 *        Copyright(c) 1985 - 2006 ROLAB, Kwangwoon University.
 *        All Rights Reserved.
 *
==============================================================================*/
/*==============================================================================
                 main에서 적절한 U16의 변수를 만든 후
                 X =  Cmps_Data(); -> X에 현재 방위각을 저장한다.
==============================================================================*/
#include <iom128.h>
#include "../define.h"
#include "../delay.h"
#include "sensor_cmps03.h"


//------------------------------------------------------------------------------
//                      초기화_CMPS03
//------------------------------------------------------------------------------
void Init_Cmps03(void)
{
    Setup();
    Start_Condition();
    Master_Mode();
}

//------------------------------------------------------------------------------
//                      초기화_I2C
//------------------------------------------------------------------------------
void Setup(void)
{
    TWBR=12;
    cbi(TWSR, TWPS0);
    cbi(TWSR, TWPS1);

    sbi(TWCR, TWEN); // TWI가 동작하는 것을 허용한다.
    cbi(TWCR, TWIE); // 인터럽트 발생하는 것을 개별적으로 허용한다.->금지
    sbi(TWCR, TWEA); // 확인신호 응답 1로 설정하여 twi 버스 활성화 시킨다.
}

//------------------------------------------------------------------------------
//                      플래그가 1이 될 때 까지 기다린다.
//------------------------------------------------------------------------------
void Wate_Complete(void)
{
    while( !(TWCR & (1<<TWINT)) );
}

//------------------------------------------------------------------------------
//                      스타트 컨디션
//------------------------------------------------------------------------------
void Start_Condition(void)
{
     TWCR = (TWCR & TWCR_CMD_MASK)|(1<<TWINT)|(1<<TWSTA);
     Wate_Complete();
}

//------------------------------------------------------------------------------
//                      어드레스 코드 송신
//------------------------------------------------------------------------------
void Master_Mode(void)
{
     TWDR = CMPSADDRESS;
     TWCR = (TWCR & TWCR_CMD_MASK)|(1<<TWINT)|(1<<TWEA);
     Wate_Complete();
}
//------------------------------------------------------------------------------
//                      데이터 수신
//------------------------------------------------------------------------------
void Recieve_Data(void)
{
     TWCR = (TWCR & TWCR_CMD_MASK)|(1<<TWINT)|(1<<TWEA);
     Wate_Complete();
}

//------------------------------------------------------------------------------
//                      데이터 수신 루프
//------------------------------------------------------------------------------
U16 Cmps_Data(void)
{
    U8 Cmps_H = 0;         //cmps High bit
    U8 Cmps_L = 0;         //cmps Losw bit
    U16 Compass = 0;       //coms = High + Low

    for(U8 Twi_Counter = 0 ; Twi_Counter < 16 ; Twi_Counter++)
    {

        Recieve_Data();

        if(Twi_Counter == 2)        //high bit저장
        {
            Cmps_H = TWDR;
        }

        if(Twi_Counter == 3)        //low bit 저장
        {
            Cmps_L = TWDR;
        }
        Delay_us(50);               //다음 방위 각이 올 때까지 걸리는 시간 50us
    }

    Compass = Cmps_H;
    Compass = (Compass << 8);
    Compass = (Compass | Cmps_L);

    return Compass;
}
