//------------------------------------------------------------------------------
//	=== Include Headerfile ===
//------------------------------------------------------------------------------
#include "main.h"		// 프로그램의 헤더파일 설정


#define	MODEREADY	0
#define MODERUN		1

//------------------------------------------------------------------------------
//                   		=== Variable Declaration ===
//------------------------------------------------------------------------------

U08 ID,TxPacketLength, RxPacketLength;
extern volatile U08 RxInterruptBuffer[256];
extern U08 RxBufferReadPointer;
extern U08 RxBufferWritePointer;

U16 tic_1sec = 0;
U08 nSEC, nMIN, nHOR;
U08 nMODE;

//------------------------------------------------------------------------------
//                   		=== Interrupt Service Routine ===
//------------------------------------------------------------------------------
ISR(TIMER0_OVF_vect)	//2ms
{
	TCNT0 = 131;
	tic_1sec++;
	if(tic_1sec >= 500)
	{
		
	}
	
}

ISR(USART0_RX_vect)
{	
	Disable_ISR();

	RxInterruptBuffer[(RxBufferWritePointer++)]= UDR0;

	Enable_ISR();
}



//------------------------------------------------------------------------------
//                      	=== Main Function ===
//------------------------------------------------------------------------------
void main(void)
{ 
	Init_Main();		// 초기화_MCU
	
	while(1)
	{         
	//--------------------------------------------------------------------------
	//		=== Function Module ===
	//--------------------------------------------------------------------------
	if(ADC_Average(0, 10) >= 200)
	{
		//nMODE = MODERUN;
		AX_Action(0, 0x02, 0x00, 0x02, 0x90);
		_delay_ms(300);
		AX_Action(0, 0x02, 0x90, 0x02, 0x90);
		_delay_ms(300);
		
	}
			
	//--------------------------------------------------------------------------    
	}
}


//------------------------------------------------------------------------------
//                       	=== Initialize Function ===
//------------------------------------------------------------------------------
void Init_Main(void)
{
	Disable_ISR();           	// 전체인터럽트 사용금지

	Init_Timer();				// 초기화_타이머0/1/2/3
    Init_Uart(0,1000000);  		// 초기화_시리얼통신0
	Init_Uart(1,57600);  	// 초기화_시리얼통신1
	Init_ADC();
	//Lcd_Init();
	//sbi(DDRE,4);
    
	Enable_ISR();            	// 전체인터럽트 사용허가
}

//------------------------------------------------------------------------------ 
//		=== Function Module ===
//------------------------------------------------------------------------------


//------------------------------------------------------------------------------
